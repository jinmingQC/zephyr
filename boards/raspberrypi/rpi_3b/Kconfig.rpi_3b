## boards/raspberrypi/rpi_3b/Kconfig.rpi_3b
```kconfig
# Copyright (c) 2026
# SPDX-License-Identifier: Apache-2.0

config BOARD_RPI_3B
	select SOC_BCM2837
```

## boards/raspberrypi/rpi_3b/board.yml
```yaml
board:
  name: rpi_3b
  full_name: Raspberry Pi 3 Model B (Cortex-A53)
  vendor: raspberrypi
  socs:
  - name: bcm2837
```

## boards/raspberrypi/rpi_3b/rpi_3b_defconfig
```kconfig
# SPDX-License-Identifier: Apache-2.0

# ARM CPU and peripherals require at least 16 MiB of virtual space.
CONFIG_KERNEL_VM_SIZE=0x1000000

# Platform configuration
CONFIG_ARM64_VA_BITS_36=y
CONFIG_ARM64_PA_BITS_36=y

# MMU options
CONFIG_MAX_XLAT_TABLES=16

# Serial console
CONFIG_SERIAL=y
CONFIG_CONSOLE=y
CONFIG_UART_CONSOLE=y

# Architectural timer
CONFIG_TIMER_READS_ITS_FREQUENCY_AT_RUNTIME=y

# The board port is intended for SMP and IPI development.
CONFIG_SMP=y
CONFIG_MP_MAX_NUM_CPUS=4

# Raspberry Pi firmware leaves the secondary cores in a spin-table loop.
CONFIG_PM_CPU_OPS=y
```

## boards/starfive/visionfive2/visionfive2_defconfig
```kconfig
# SPDX-License-Identifier: Apache-2.0

# Zephyr Kernel Configuration
CONFIG_PRINTK=y
CONFIG_XIP=n
CONFIG_RV_BOOT_HART=1
CONFIG_SMP=y
CONFIG_MP_MAX_NUM_CPUS=4

# Serial Drivers
CONFIG_SERIAL=y
CONFIG_CONSOLE=y
CONFIG_UART_CONSOLE=y
```

## dts/bindings/interrupt-controller/brcm,bcm2836-l1-intc.yaml
```yaml
# Copyright (c) 2026
# SPDX-License-Identifier: Apache-2.0

compatible: "brcm,bcm2836-l1-intc"

include: base.yaml

properties:
  reg:
    required: true

interrupt-cells:
  - irq
  - priority
  - flags

description: |
  Broadcom BCM2836 per-core local interrupt controller.

  Flat interrupt namespace used by the Zephyr BCM2837 port. Interrupts 0-3
  are the local architectural timer sources, 4-7 are local mailboxes 0-3,
  and 32-95 represent BCM2835 ARMCTRL GPU interrupts 0-63.
```

## soc/brcm/bcm2837/Kconfig
```kconfig
# Copyright (c) 2026
# SPDX-License-Identifier: Apache-2.0

config SOC_BCM2837
	select ARM64
	select CPU_CORTEX_A53
	select ARM_ARCH_TIMER if SYS_CLOCK_EXISTS
	select ARM_CUSTOM_INTERRUPT_CONTROLLER
	help
	  Broadcom BCM2837 used by Raspberry Pi 3 Model B.
```

## soc/brcm/bcm2837/Kconfig.defconfig
```kconfig
# Copyright (c) 2026
# SPDX-License-Identifier: Apache-2.0

if SOC_BCM2837

config NUM_IRQS
	default 96

config SYS_CLOCK_HW_CYCLES_PER_SEC
	default $(dt_node_int_prop_int,/cpus/cpu@0,clock-frequency)

config MP_MAX_NUM_CPUS
	default 4

configdefault CACHE_MANAGEMENT
	default y

endif
```

## soc/brcm/bcm2837/Kconfig.soc
```kconfig
# Copyright (c) 2026
# SPDX-License-Identifier: Apache-2.0

config SOC_BCM2837
	bool

config SOC
	default "bcm2837" if SOC_BCM2837
```

## subsys/debug/debugpoint/Kconfig
```kconfig
# SPDX-License-Identifier: Apache-2.0

config ARCH_HAS_DEBUGPOINT_SMP
	bool
	help
	  The architecture can reconcile per-CPU debug hardware from IPI
	  context using arch_debugpoint_cpu_sync().

config DEBUGPOINT
	bool
	depends on MULTITHREADING
	depends on !SMP || ARCH_HAS_DEBUGPOINT_SMP
	depends on !SMP_BOOT_DELAY
	help
	  Internal hardware debugpoint framework.

config DEBUGPOINT_MAX_SLOTS
	int
	default 8
	range 1 32
	depends on DEBUGPOINT
```

## subsys/debug/watchpoint/Kconfig
```kconfig
# SPDX-License-Identifier: Apache-2.0

menuconfig WATCHPOINT
	bool "Memory watchpoints"
	help
	  Enable callbacks for monitored memory reads and writes. Events report
	  the triggering PC and, when available, the accessed address.

	  Watchpoints use on-chip debug resources and are limited by the
	  capabilities and number of comparators provided by each CPU.

if WATCHPOINT

config WATCHPOINT_HW
	bool "Hardware watchpoint backend"
	default y
	depends on MULTITHREADING
	depends on ARCH_HAS_WATCHPOINT
	depends on !SMP || ARCH_HAS_DEBUGPOINT_SMP
	depends on !SMP_BOOT_DELAY
	select DEBUGPOINT
	help
	  Use architecture debug trigger registers to monitor memory accesses
	  without instrumenting normal load and store instructions.

	  The number of simultaneously active watchpoints is limited by the
	  hardware, typically two to four slots.

config WATCHPOINT_CALLSTACK
	bool "Capture call stack on watchpoint hit"
	depends on WATCHPOINT_HW
	depends on ARCH_STACKWALK
	help
	  Capture a bounded call stack when a watchpoint fires and expose it
	  through the watchpoint callback event.

config WATCHPOINT_CALLSTACK_DEPTH
	int "Maximum watchpoint call stack depth"
	default 8
	range 1 32
	depends on WATCHPOINT_CALLSTACK
	help
	  Maximum number of return addresses captured for each watchpoint hit.

endif # WATCHPOINT
```

## tests/debug/watchpoint/testcase.yaml
```yaml
tests:
  debug.watchpoint:
    tags:
      - debug
      - watchpoint
    platform_allow:
      - qemu_riscv32
      - qemu_riscv64
      - qemu_cortex_m3
      - qemu_cortex_a53
    integration_platforms:
      - qemu_riscv32
      - qemu_riscv64

  debug.watchpoint.smp:
    tags:
      - debug
      - watchpoint
      - smp
    platform_allow:
      - qemu_riscv32/qemu_virt_riscv32/smp
      - qemu_riscv64/qemu_virt_riscv64/smp
      - qemu_cortex_a53/qemu_cortex_a53/smp
    integration_platforms:
      - qemu_riscv32/qemu_virt_riscv32/smp
      - qemu_riscv64/qemu_virt_riscv64/smp
      - qemu_cortex_a53/qemu_cortex_a53/smp
    extra_configs:
      - CONFIG_SCHED_CPU_MASK=y
  debug.watchpoint.userspace:
    tags:
      - debug
      - watchpoint
      - userspace
    platform_allow:
      - qemu_riscv32
      - qemu_riscv64
      - qemu_cortex_a53
    integration_platforms:
      - qemu_riscv32
      - qemu_riscv64
      - qemu_cortex_a53
    extra_configs:
      - CONFIG_USERSPACE=y
```
