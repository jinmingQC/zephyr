## Kconfig
```kconfig
# SPDX-License-Identifier: Apache-2.0

menuconfig CPP_RUNTIME
	bool "Source-built libc++ thread runtime"
	depends on CPP
	select THREAD_LOCAL_STORAGE
	help
	  Build matching libc++ and libc++abi sources with the application's
	  compiler and configuration. This experimental profile supports C++17
	  threading and synchronization in supervisor mode.

if CPP_RUNTIME

config CPP_RUNTIME_THREAD_MAX
	int "Maximum simultaneous standard threads"
	default 8
	range 4 64

config CPP_RUNTIME_THREAD_STACK_SIZE
	int "Stack size per standard thread"
	default 4096
	range 1024 65536

config CPP_RUNTIME_THREAD_PRIORITY
	int "Default standard thread priority"
	default 5
	range 0 14
	help
	  The native backend uses this priority. POSIX inherits the creator's
	  priority; applications must choose matching priorities for comparison.

config CPP_RUNTIME_TLS_KEYS
	int "Thread-specific storage key capacity"
	default 8
	range 2 64

rsource "backend/Kconfig.native"

endif # CPP_RUNTIME
```

## backend/Kconfig.native
```kconfig
# SPDX-License-Identifier: Apache-2.0

config CPP_RUNTIME_NATIVE
	bool
	default y
	help
	  Use a small libc++ external thread adapter directly over Zephyr APIs.

if CPP_RUNTIME_NATIVE && USERSPACE

config CPP_RUNTIME_MUTEX_MAX
	int "Maximum live native mutex handles"
	default 64
	range 8 255
	help
	  Includes libc++ internal locks, shared_mutex and timed_mutex internals.
	  Kernel objects remain private; application mutexes contain only handles.

config CPP_RUNTIME_CONDVAR_MAX
	int "Maximum live native condition variable handles"
	default 32
	range 4 255

endif
```

## backend/Kconfig.posix
```kconfig
# SPDX-License-Identifier: Apache-2.0

config CPP_RUNTIME_POSIX
	bool
	depends on POSIX_SYSTEM_INTERFACES
	default y
	select DYNAMIC_THREAD
	select POSIX_THREADS
	select POSIX_TIMERS
	select THREAD_LOCAL_STORAGE
	select THREAD_STACK_INFO
	help
	  Use libc++'s upstream pthread backend and Zephyr's POSIX subsystem.
	  The module supplies language TLS exit ordering and native caller
	  identities; native identities do not adopt threads into POSIX.
	  Applications must enable POSIX_SYSTEM_INTERFACES explicitly.

if CPP_RUNTIME_POSIX

config POSIX_THREAD_THREADS_MAX
	default CPP_RUNTIME_THREAD_MAX

config POSIX_THREAD_KEYS_MAX
	default CPP_RUNTIME_TLS_KEYS

config DYNAMIC_THREAD_STACK_SIZE
	default CPP_RUNTIME_THREAD_STACK_SIZE

config DYNAMIC_THREAD_POOL_SIZE
	default CPP_RUNTIME_THREAD_MAX

config MAX_PTHREAD_MUTEX_COUNT
	default 16

config MAX_PTHREAD_COND_COUNT
	default 16

endif # CPP_RUNTIME_POSIX
```

## benchmarks/minimal/testcase.yaml
```yaml
# SPDX-FileCopyrightText: Copyright The Zephyr Project Contributors
# SPDX-License-Identifier: Apache-2.0

tests:
  cpp.runtime.minimal_footprint:
    tags:
      - cpp
      - footprint
    toolchain_allow:
      - zephyr/gnu
      - zephyr/llvm
    integration_platforms:
      - mps2/an385
    build_only: true
    min_ram: 128
```

## benchmarks/thread_sync/testcase.yaml
```yaml
# SPDX-FileCopyrightText: Copyright The Zephyr Project Contributors
# SPDX-License-Identifier: Apache-2.0

tests:
  cpp.runtime.thread_benchmark:
    tags:
      - cpp
      - benchmark
    toolchain_allow:
      - zephyr/gnu
      - zephyr/llvm
    integration_platforms:
      - mps2/an385
    harness: console
    harness_config:
      type: one_line
      regex:
        - "CPP_BENCH_DONE"
    min_ram: 128
    timeout: 180
```

## lib/cpp/libcxx/Kconfig
```kconfig
# SPDX-FileCopyrightText: Copyright The Zephyr Project Contributors
# SPDX-License-Identifier: Apache-2.0

if LIBCXX_SOURCE_LIBCPP

config LIBCXX_THREAD_MAX
	int "Maximum number of libc++ threads"
	default 8
	range 1 64
	help
	  Number of statically allocated thread objects and stacks. Joined
	  threads release their slot immediately; exited detached threads
	  are reclaimed by the next thread creation.

config LIBCXX_THREAD_STACK_SIZE
	int "Stack size of each libc++ thread"
	default 4096
	range 1024 65536

config LIBCXX_THREAD_PRIORITY
	int "Default priority of libc++ threads"
	default 5
	range 0 14
	help
	  Preemptible Zephyr priority. Must be less than NUM_PREEMPT_PRIORITIES.

config LIBCXX_TLS_KEYS
	int "Number of libc++ thread-specific storage keys"
	default 8
	range 2 64

config LIBCXX_FILESYSTEM
	bool "Native Zephyr filesystem backend"
	depends on FILE_SYSTEM
	help
	  Enable C++17 filesystem paths, directory iteration and native file
	  operations. LittleFS supports identity-sensitive copy and equivalent.
	  Timestamps, permissions and links return ENOTSUP.

if LIBCXX_FILESYSTEM

config LIBCXX_FILESYSTEM_PATH_MAX
	int "Maximum filesystem path storage in bytes"
	default 512
	range 64 4096

config LIBCXX_FILESYSTEM_TEMP_DIR
	string "Filesystem temporary directory"
	default "/tmp"
	help
	  Existing absolute directory returned by temp_directory_path().
	  The application must mount and create this directory first.

endif # LIBCXX_FILESYSTEM

endif # LIBCXX_SOURCE_LIBCPP
```

## subsys/debug/kasan/Kconfig
```kconfig
# SPDX-License-Identifier: Apache-2.0

config KASAN
	bool
	help
	  Common lightweight Kernel Address Sanitizer runtime. This is selected
	  by one or more KASAN shadow providers.

config KASAN_INSTRUMENT_READS
	bool "Instrument memory reads"
	depends on KASAN
	default y
	help
	  Instrument reads as well as writes in sources opted in to KASAN.
	  Disabling this reduces runtime overhead, but prevents detection of
	  out-of-bounds and use-after-free reads.

config KASAN_GLOBAL
	bool "Global variable address sanitizer"
	depends on !ASAN
	depends on !CMAKE_LINKER_GENERATOR
	select KASAN
	select STATIC_INIT_GNU
	help
	  Detect invalid accesses to compiler-generated redzones around global
	  and function-static variables in sources opted in to KASAN.

	  GCC emits a descriptor and an initialization function for each
	  instrumented translation unit. The KASAN runtime registers those
	  descriptors during static initialization and indexes them by address.
	  GCC and Clang emit compatible descriptors in the supported
	  kernel-address mode. Clang may omit source location metadata.
	  Descriptors become active after POST_KERNEL initialization, when Zephyr
	  runs GNU constructors, and before APPLICATION initialization. Accesses
	  made during earlier init levels are therefore outside the coverage.

	  This option does not instrument sources automatically. Use
	  zephyr_target_enable_kasan() or zephyr_kasan_enable_directory() from
	  the application's CMakeLists.txt.

config KASAN_GLOBAL_MAX_OBJECTS
	int "Maximum number of tracked global objects"
	depends on KASAN_GLOBAL
	range 1 4096
	default 256
	help
	  Maximum number of compiler-emitted global descriptors kept in the
	  address index. Each entry consumes one pointer. Initialization stops
	  with a fatal error rather than silently leaving objects unprotected if
	  this limit is exceeded.
```
