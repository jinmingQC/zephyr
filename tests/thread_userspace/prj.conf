## CMakeLists.txt
```
# SPDX-License-Identifier: Apache-2.0

cmake_minimum_required(VERSION 3.28.0)
find_package(Zephyr REQUIRED HINTS $ENV{ZEPHYR_BASE})
project(cpp_runtime_thread_userspace)

zephyr_include_directories(include)
target_sources(app PRIVATE src/main.cpp src/user_test_helpers.c)

# Compiler-generated guard variables are ordinary writable application data.
# This application archive uses the same partition mapping as
# zephyr_library_app_memory(), without creating a kernel-mode Zephyr library.
add_library(cpp_userspace_static_test STATIC src/static_local.cpp)
target_link_libraries(cpp_userspace_static_test PUBLIC zephyr_interface)
add_dependencies(cpp_userspace_static_test zephyr_generated_headers)
target_link_libraries(app PUBLIC cpp_userspace_static_test)
set_property(TARGET zephyr_property_target APPEND PROPERTY COMPILE_OPTIONS
  "-l" "$<TARGET_FILE_NAME:cpp_userspace_static_test>" "ztest_mem_partition"
)
```

## prj.conf
```kconfig
# SPDX-License-Identifier: Apache-2.0

CONFIG_CPP=y
CONFIG_STD_CPP17=y
CONFIG_CPP_RUNTIME=y
CONFIG_EXTERNAL_MODULE_LIBCPP=y
CONFIG_PICOLIBC=y
CONFIG_CPP_EXCEPTIONS=n
CONFIG_CPP_RTTI=n
CONFIG_THREAD_LOCAL_STORAGE=y

CONFIG_USERSPACE=y
CONFIG_TEST_USERSPACE=y
CONFIG_APPLICATION_DEFINED_SYSCALL=y
CONFIG_ZTEST=y
CONFIG_ZTEST_STACK_SIZE=8192
CONFIG_ZTEST_THREAD_PRIORITY=5
CONFIG_MAIN_STACK_SIZE=4096
CONFIG_MAIN_THREAD_PRIORITY=5
CONFIG_SYSTEM_WORKQUEUE_STACK_SIZE=4096

CONFIG_CPP_RUNTIME_THREAD_MAX=8
CONFIG_CPP_RUNTIME_THREAD_STACK_SIZE=4096
CONFIG_CPP_RUNTIME_THREAD_PRIORITY=5
CONFIG_CPP_RUNTIME_TLS_KEYS=8

CONFIG_COMMON_LIBC_MALLOC=y
CONFIG_COMMON_LIBC_MALLOC_ARENA_SIZE=65536
CONFIG_HEAP_MEM_POOL_SIZE=16384
CONFIG_POSIX_SYSTEM_INTERFACES=y
CONFIG_POSIX_TIMERS=y
CONFIG_POSIX_MONOTONIC_CLOCK=y
```

## smp2.conf
```kconfig
# SPDX-License-Identifier: Apache-2.0

CONFIG_SMP=y
CONFIG_MP_MAX_NUM_CPUS=2
```

## boards/mps2_an385.conf
```kconfig
# SPDX-License-Identifier: Apache-2.0
# Cortex-M3 has eight MPU regions. Ztest adds a fourth application partition
# (libc, malloc, runtime, test harness), so its optional privileged-stack guard
# would exceed the hardware budget. User/kernel and private user-stack
# isolation remain enabled. The non-Ztest sample can retain stack protection.
CONFIG_TEST_HW_STACK_PROTECTION=n
```

## include/user_test_helpers.h
```c
/* SPDX-License-Identifier: Apache-2.0 */
#ifndef CPP_USER_TEST_HELPERS_H_
#define CPP_USER_TEST_HELPERS_H_

#include <stdint.h>
#include <zephyr/kernel.h>

#ifdef __cplusplus
extern "C" {
#endif

/* Test instrumentation only: ARM's raw cycle accessor is privileged. */
__syscall uint32_t cpp_test_cycle_get32(void);

#ifdef __cplusplus
}
#endif

#include <zephyr/syscalls/user_test_helpers.h>
#endif
```

## src/static_local.cpp
```c
/* SPDX-License-Identifier: Apache-2.0 */

#include <atomic>
#include <chrono>
#include <thread>
#include <cstdint>

namespace {

std::atomic<uint32_t> user_constructions{0};
std::atomic<uint32_t> supervisor_constructions{0};

struct guarded_value {
	explicit guarded_value(std::atomic<uint32_t> &constructions)
	{
		constructions.fetch_add(1);
		std::this_thread::sleep_for(std::chrono::milliseconds(10));
		value = 42;
	}

	uint32_t value = 0;
};

} /* namespace */

uint32_t user_static_value()
{
	static guarded_value object(user_constructions);

	return object.value;
}

uint32_t supervisor_static_value()
{
	static guarded_value object(supervisor_constructions);

	return object.value;
}

uint32_t user_static_constructions()
{
	return user_constructions.load();
}

uint32_t supervisor_static_constructions()
{
	return supervisor_constructions.load();
}
```

## src/user_test_helpers.c
```c
// SPDX-License-Identifier: Apache-2.0

#include <user_test_helpers.h>
#include <zephyr/internal/syscall_handler.h>

uint32_t z_impl_cpp_test_cycle_get32(void)
{
	return k_cycle_get_32();
}

static inline uint32_t z_vrfy_cpp_test_cycle_get32(void)
{
	return z_impl_cpp_test_cycle_get32();
}
#include <zephyr/syscalls/cpp_test_cycle_get32_mrsh.c>
```
