## CMakeLists.txt
```
# Copyright (c) Qualcomm Technologies, Inc. and/or its subsidiaries.
# SPDX-License-Identifier: Apache-2.0

cmake_minimum_required(VERSION 3.28.0)
find_package(Zephyr REQUIRED HINTS $ENV{ZEPHYR_BASE})
project(kernel_latency_monitor)

target_include_directories(app PRIVATE ${ZEPHYR_BASE}/kernel/include)
target_sources(app PRIVATE src/main.c src/timing.c)
target_sources_ifdef(CONFIG_SHELL_BACKEND_DUMMY app PRIVATE src/shell.c)

if(CONFIG_SHELL_BACKEND_DUMMY)
  target_link_options(app PUBLIC -Wl,--wrap=z_latency_monitor_stats_get)
endif()

# Observe scheduler/idle handoffs and control timing without changing production hooks.
target_link_options(app PUBLIC
  -Wl,--wrap=sys_clock_cycle_get_32
  -Wl,--wrap=arch_cpu_idle
  -Wl,--wrap=arch_cpu_atomic_idle
  -Wl,--wrap=z_pend_curr
  -Wl,--wrap=z_latency_monitor_spin_released
)
```

## prj.conf
```kconfig
# Copyright (c) Qualcomm Technologies, Inc. and/or its subsidiaries.
# SPDX-License-Identifier: Apache-2.0

CONFIG_ZTEST=y
CONFIG_IRQ_OFFLOAD=y
CONFIG_KERNEL_LATENCY_MONITOR=y
```

## src/main.c
```c
/*
 * Copyright (c) Qualcomm Technologies, Inc. and/or its subsidiaries.
 * SPDX-License-Identifier: Apache-2.0
 */

#include <errno.h>

#include <zephyr/arch/cpu.h>
#include <zephyr/kernel.h>
#include <zephyr/irq_offload.h>
#include <zephyr/kernel/smp.h>
#include <zephyr/kernel_structs.h>
#include <zephyr/spinlock.h>
#include <zephyr/sys/atomic.h>
#include <zephyr/ztest.h>

#include <latency_monitor.h>

#define MEASURE_US 1000U

static struct k_spinlock measured_lock;

static void check_record(const struct z_latency_monitor_record *record,
			 const struct k_spinlock *spinlock, const struct k_thread *thread,
			 bool in_isr)
{
	zassert_true(record->cycles > 0U, "no latency was recorded");
	zassert_not_equal(record->caller, 0U, "call site was not captured");
	zassert_equal_ptr(record->spinlock, spinlock, "wrong spinlock");
	zassert_equal_ptr(record->thread, thread, "wrong thread");
	zassert_equal(record->in_isr, in_isr, "wrong execution context");
}

ZTEST(kernel_latency_monitor, test_nested_irq_lock_is_one_interval)
{
	struct z_latency_monitor_stats stats;
	const struct k_thread *thread = k_current_get();
	unsigned int outer_key;
	unsigned int inner_key;
	unsigned int cpu;

	outer_key = k_irq_lock();
	cpu = CPU_ID;
	z_latency_monitor_stats_reset();

	k_busy_wait(MEASURE_US / 2U);
	inner_key = irq_lock();
	k_busy_wait(MEASURE_US / 2U);
	irq_unlock(inner_key);
	zassert_ok(z_latency_monitor_stats_get(cpu, &stats));
	zassert_equal(stats.max[Z_LATENCY_MONITOR_EVENT_IRQ_LOCKED].cycles, 0U);
	k_busy_wait(MEASURE_US / 2U);
	z_latency_monitor_irq_end(outer_key);
	zassert_ok(z_latency_monitor_stats_get(cpu, &stats));
	k_irq_unlock(outer_key);

	check_record(&stats.max[Z_LATENCY_MONITOR_EVENT_IRQ_LOCKED], NULL, thread, false);
	zassert_true(stats.max[Z_LATENCY_MONITOR_EVENT_IRQ_LOCKED].cycles >=
		     k_us_to_cyc_floor32(MEASURE_US * 3U / 2U));
	zassert_equal(stats.max[Z_LATENCY_MONITOR_EVENT_SPINLOCK_HOLD].cycles, 0U);
	zassert_equal(stats.max[Z_LATENCY_MONITOR_EVENT_SPINLOCK_WAIT].cycles, 0U);
	zassert_equal(stats.spinlock_tracking_overflows, 0U);
}

ZTEST(kernel_latency_monitor, test_public_spin_unlock)
{
	struct z_latency_monitor_stats stats;
	unsigned int cpu;
	k_spinlock_key_t key;

	k_sched_lock();
	z_latency_monitor_stats_reset();
	key = k_spin_lock(&measured_lock);
	cpu = CPU_ID;
	k_busy_wait(MEASURE_US);
	k_spin_unlock(&measured_lock, key);
	zassert_ok(z_latency_monitor_stats_get(cpu, &stats));
	k_sched_unlock();

	check_record(&stats.max[Z_LATENCY_MONITOR_EVENT_SPINLOCK_HOLD], &measured_lock,
		     k_current_get(), false);
	check_record(&stats.max[Z_LATENCY_MONITOR_EVENT_IRQ_LOCKED], &measured_lock,
		     k_current_get(), false);
	zassert_true(stats.max[Z_LATENCY_MONITOR_EVENT_SPINLOCK_HOLD].cycles >=
		     k_us_to_cyc_floor32(MEASURE_US));
	zassert_true(stats.max[Z_LATENCY_MONITOR_EVENT_IRQ_LOCKED].cycles >=
		     stats.max[Z_LATENCY_MONITOR_EVENT_SPINLOCK_HOLD].cycles);
	zassert_equal(stats.spinlock_tracking_overflows, 0U);
#ifndef CONFIG_SMP
	zassert_equal(stats.max[Z_LATENCY_MONITOR_EVENT_SPINLOCK_WAIT].cycles, 0U);
#endif
}

K_TIMER_DEFINE(idle_wakeup, NULL, NULL);

static struct z_latency_monitor_stats *idle_snapshots[CONFIG_MP_MAX_NUM_CPUS];

void __real_arch_cpu_atomic_idle(unsigned int key);
void __wrap_arch_cpu_atomic_idle(unsigned int key);
void __real_arch_cpu_idle(void);
void __wrap_arch_cpu_idle(void);

static void snapshot_before_idle(void)
{
	unsigned int cpu = CPU_ID;

	/* Capture before IRQs are enabled: unrelated records cannot replace it. */
	if (idle_snapshots[cpu] != NULL) {
		(void)z_latency_monitor_stats_get(cpu, idle_snapshots[cpu]);
		idle_snapshots[cpu] = NULL;
	}
}

void __wrap_arch_cpu_atomic_idle(unsigned int key)
{
	snapshot_before_idle();
	__real_arch_cpu_atomic_idle(key);
}

void __wrap_arch_cpu_idle(void)
{
	snapshot_before_idle();
	__real_arch_cpu_idle();
}

static void check_idle_handoff(bool atomic_idle)
{
	struct z_latency_monitor_stats stats = {0};
	k_spinlock_key_t key;
	unsigned int cpu;
	unsigned int irq_key;
	bool irqs_enabled;

	k_sched_lock();
	k_timer_start(&idle_wakeup, K_MSEC(10), K_NO_WAIT);
	key = k_spin_lock(&measured_lock);
	cpu = CPU_ID;
	z_latency_monitor_stats_reset();
	k_busy_wait(MEASURE_US);
	/* Do not carry an SMP global IRQ lock across idle. */
	k_spin_release(&measured_lock);
	idle_snapshots[cpu] = &stats;
	if (atomic_idle) {
		k_cpu_atomic_idle(key.key);
	} else {
		k_cpu_idle();
	}

	irq_key = arch_irq_lock();
	irqs_enabled = arch_irq_unlocked(irq_key);
	arch_irq_unlock(irq_key);
	k_timer_stop(&idle_wakeup);
	k_sched_unlock();

	zassert_true(irqs_enabled, "idle did not restore IRQs");
	check_record(&stats.max[Z_LATENCY_MONITOR_EVENT_IRQ_LOCKED], &measured_lock,
		     k_current_get(), false);
	zassert_true(stats.max[Z_LATENCY_MONITOR_EVENT_IRQ_LOCKED].cycles >=
		     k_us_to_cyc_floor32(MEASURE_US));
}

ZTEST(kernel_latency_monitor, test_atomic_idle_closes_irq_interval)
{
	check_idle_handoff(true);
}

ZTEST(kernel_latency_monitor, test_idle_closes_irq_interval)
{
	check_idle_handoff(false);
}

ZTEST(kernel_latency_monitor, test_stats_arguments)
{
	struct z_latency_monitor_stats stats;

	zassert_equal(z_latency_monitor_stats_get(arch_num_cpus(), &stats), -EINVAL);
	zassert_equal(z_latency_monitor_stats_get(0U, NULL), -EINVAL);
}

static struct z_latency_monitor_stats isr_stats;
static int isr_stats_result;

static void measure_from_isr(const void *parameter)
{
	struct k_spinlock *lock = (struct k_spinlock *)parameter;
	k_spinlock_key_t key;
	unsigned int cpu;

	key = k_spin_lock(lock);
	cpu = CPU_ID;
	z_latency_monitor_stats_reset();
	k_busy_wait(MEASURE_US);
	k_spin_release(lock);
	isr_stats_result = z_latency_monitor_stats_get(cpu, &isr_stats);
	arch_irq_unlock(key.key);
}

ZTEST(kernel_latency_monitor, test_isr_metadata)
{
	const struct k_thread *thread = k_current_get();

	isr_stats_result = -ENODATA;
	irq_offload(measure_from_isr, &measured_lock);

	zassert_ok(isr_stats_result);
	check_record(&isr_stats.max[Z_LATENCY_MONITOR_EVENT_SPINLOCK_HOLD], &measured_lock, thread,
		     true);
}

#ifndef CONFIG_SMP

#define HANDOFF_STACK_SIZE (1536 + CONFIG_TEST_EXTRA_STACK_SIZE)

K_THREAD_STACK_DEFINE(handoff_stack, HANDOFF_STACK_SIZE);

static struct k_thread handoff_thread;
static struct z_latency_monitor_stats handoff_stats;
static int handoff_stats_result;

static void snapshot_after_handoff(void *p1, void *p2, void *p3)
{
	ARG_UNUSED(p1);
	ARG_UNUSED(p2);
	ARG_UNUSED(p3);

	handoff_stats_result = z_latency_monitor_stats_get(CPU_ID, &handoff_stats);
}

ZTEST(kernel_latency_monitor, test_scheduler_handoff_attribution)
{
	const struct z_latency_monitor_record *record;
	k_tid_t origin = k_current_get();
	k_tid_t thread;

	thread = k_thread_create(&handoff_thread, handoff_stack,
				 K_THREAD_STACK_SIZEOF(handoff_stack), snapshot_after_handoff, NULL,
				 NULL, NULL, k_thread_priority_get(origin), 0, K_FOREVER);

	handoff_stats_result = -ENODATA;
	k_thread_start(thread);
	z_latency_monitor_stats_reset();

	/*
	 * Yielding transfers _current to handoff_thread before the scheduler
	 * spinlock is physically released. The record must retain origin.
	 */
	k_yield();

	zassert_ok(k_thread_join(thread, K_SECONDS(1)));
	zassert_ok(handoff_stats_result);

	record = &handoff_stats.max[Z_LATENCY_MONITOR_EVENT_IRQ_LOCKED];
	zassert_not_null(record->spinlock, "scheduler spinlock was not recorded");
	check_record(record, record->spinlock, origin, false);
}

#endif /* !CONFIG_SMP */

#ifdef CONFIG_SMP

#define WORKER_STACK_SIZE (1536 + CONFIG_TEST_EXTRA_STACK_SIZE)
K_THREAD_STACK_DEFINE(waiter_stack, WORKER_STACK_SIZE);

static struct k_thread waiter_thread;
static struct k_spinlock contention_lock;
static atomic_t holder_locked;
static atomic_t waiter_tried;
static struct z_latency_monitor_stats waiter_stats;
static int waiter_trylock_result;

static void waiter_fn(void *p1, void *p2, void *p3)
{
	k_spinlock_key_t try_key;
	unsigned int irq_key;
	unsigned int cpu;

	ARG_UNUSED(p1);
	ARG_UNUSED(p2);
	ARG_UNUSED(p3);

	while (atomic_get(&holder_locked) == 0) {
		k_yield();
	}

	irq_key = arch_irq_lock();
	z_latency_monitor_stats_reset();
	waiter_trylock_result = k_spin_trylock(&contention_lock, &try_key);
	atomic_set(&waiter_tried, 1);
	(void)k_spin_lock(&contention_lock);
	cpu = CPU_ID;
	k_spin_release(&contention_lock);
	(void)z_latency_monitor_stats_get(cpu, &waiter_stats);
	arch_irq_unlock(irq_key);
}

ZTEST(kernel_latency_monitor, test_smp_spin_contention)
{
	struct z_latency_monitor_stats holder_stats;
	k_tid_t holder = k_current_get();
	k_spinlock_key_t key;
	unsigned int cpu;
	k_tid_t waiter;

	atomic_clear(&holder_locked);
	atomic_clear(&waiter_tried);
	waiter_trylock_result = 0;

	k_sched_lock();
	cpu = arch_curr_cpu()->id;
	waiter = k_thread_create(&waiter_thread, waiter_stack, K_THREAD_STACK_SIZEOF(waiter_stack),
				 waiter_fn, NULL, NULL, NULL, K_PRIO_PREEMPT(1), 0, K_FOREVER);
	zassert_ok(k_thread_cpu_pin(waiter, (cpu + 1U) % arch_num_cpus()));
	k_thread_start(waiter);

	key = k_spin_lock(&contention_lock);
	z_latency_monitor_stats_reset();
	atomic_set(&holder_locked, 1);
	while (atomic_get(&waiter_tried) == 0) {
		arch_spin_relax();
	}
	k_busy_wait(MEASURE_US);
	k_spin_release(&contention_lock);
	z_latency_monitor_irq_end(key.key);
	(void)z_latency_monitor_stats_get(cpu, &holder_stats);
	arch_irq_unlock(key.key);
	k_sched_unlock();
	zassert_ok(k_thread_join(waiter, K_SECONDS(5)));

	zassert_equal(waiter_trylock_result, -EBUSY);
	check_record(&holder_stats.max[Z_LATENCY_MONITOR_EVENT_SPINLOCK_HOLD], &contention_lock,
		     holder, false);
	check_record(&waiter_stats.max[Z_LATENCY_MONITOR_EVENT_SPINLOCK_WAIT], &contention_lock,
		     &waiter_thread, false);
	zassert_equal(holder_stats.spinlock_tracking_overflows, 0U);
	zassert_equal(waiter_stats.spinlock_tracking_overflows, 0U);
}
#endif /* CONFIG_SMP */

static void *monitor_setup(void)
{
#if defined(CONFIG_SMP) && DT_PROP_OR(DT_PATH(cpus, cpu_1), zephyr_deferred_start, 0)
	k_smp_cpu_start(1, NULL, NULL);
#endif

	return NULL;
}

ZTEST_SUITE(kernel_latency_monitor, NULL, monitor_setup, NULL, NULL, NULL);
```

## src/shell.c
```c
/*
 * Copyright (c) Qualcomm Technologies, Inc. and/or its subsidiaries.
 *
 * SPDX-License-Identifier: Apache-2.0
 */

#include <errno.h>
#include <stdio.h>
#include <string.h>

#include <zephyr/kernel.h>
#include <zephyr/kernel_structs.h>
#include <zephyr/shell/shell.h>
#include <zephyr/shell/shell_dummy.h>
#include <zephyr/sys/atomic.h>
#include <zephyr/ztest.h>

#include <latency_monitor.h>

static atomic_t busy_cpu_zero;

int __real_z_latency_monitor_stats_get(unsigned int cpu, struct z_latency_monitor_stats *stats);
int __wrap_z_latency_monitor_stats_get(unsigned int cpu, struct z_latency_monitor_stats *stats);

int __wrap_z_latency_monitor_stats_get(unsigned int cpu, struct z_latency_monitor_stats *stats)
{
	if (cpu == 0U && atomic_get(&busy_cpu_zero) != 0) {
		return -EAGAIN;
	}
	return __real_z_latency_monitor_stats_get(cpu, stats);
}

ZTEST(kernel_latency_monitor_shell, test_busy_cpu_does_not_stop_output)
{
	const struct shell *sh = shell_backend_dummy_get_ptr();
	const char *output;
	size_t size;
	int ret;

	shell_backend_dummy_clear_output(sh);
	atomic_set(&busy_cpu_zero, 1);
	ret = shell_execute_cmd(sh, "kernel latency");
	atomic_clear(&busy_cpu_zero);

	zassert_equal(ret, -EAGAIN);
	output = shell_backend_dummy_get_output(sh, &size);
	zassert_not_null(strstr(output, "CPU 0: statistics busy; try again"));
	for (unsigned int cpu = 1U; cpu < arch_num_cpus(); ++cpu) {
		char heading[32];

		snprintf(heading, sizeof(heading), "CPU %u:", cpu);
		zassert_not_null(strstr(output, heading), "missing %s after busy CPU", heading);
	}
}

ZTEST(kernel_latency_monitor_shell, test_output_is_read_only)
{
	const struct shell *sh = shell_backend_dummy_get_ptr();
	struct z_latency_monitor_stats before;
	struct z_latency_monitor_stats after;
	struct k_spinlock lock = {0};
	k_spinlock_key_t key;
	unsigned int cpu;
	const char *output;
	size_t size;

	key = k_spin_lock(&lock);
	cpu = CPU_ID;
	k_busy_wait(1000U);
	k_spin_unlock(&lock, key);
	zassert_ok(z_latency_monitor_stats_get(cpu, &before));
	zassert_true(before.max[Z_LATENCY_MONITOR_EVENT_SPINLOCK_HOLD].cycles > 0U);

	shell_backend_dummy_clear_output(sh);
	zassert_ok(shell_execute_cmd(sh, "kernel latency"));
	output = shell_backend_dummy_get_output(sh, &size);
	zassert_true(size > 0U);

	for (unsigned int i = 0U; i < arch_num_cpus(); ++i) {
		char heading[32];

		snprintf(heading, sizeof(heading), "CPU %u:", i);
		zassert_not_null(strstr(output, heading), "missing %s", heading);
	}
	zassert_not_null(strstr(output, "irq-locked: cycles="));
	zassert_not_null(strstr(output, "spin-wait: cycles="));
	zassert_not_null(strstr(output, "spin-hold: cycles="));
	zassert_not_null(strstr(output, " ns="));
	zassert_not_null(strstr(output, " caller=0x"));
	zassert_not_null(strstr(output, " lock="));
	zassert_not_null(strstr(output, " thread="));
	zassert_not_null(strstr(output, " isr="));
	zassert_not_null(strstr(output, "tracking overflows:"));

	zassert_equal(shell_execute_cmd(sh, "kernel latency reset"), -EINVAL);
	zassert_ok(z_latency_monitor_stats_get(cpu, &after));

	/* Shell activity can raise the maxima, but reading must not clear them. */
	for (size_t i = 0U; i < ARRAY_SIZE(before.max); ++i) {
		zassert_true(after.max[i].cycles >= before.max[i].cycles);
	}
	zassert_true(after.spinlock_tracking_overflows >= before.spinlock_tracking_overflows);
}

static void *shell_setup(void)
{
	const struct shell *sh = shell_backend_dummy_get_ptr();

	WAIT_FOR(shell_ready(sh), 20000, k_msleep(1));
	zassert_true(shell_ready(sh), "timed out waiting for dummy shell backend");
	return NULL;
}

ZTEST_SUITE(kernel_latency_monitor_shell, NULL, shell_setup, NULL, NULL, NULL);
```

## src/timing.c
```c
/*
 * Copyright (c) Qualcomm Technologies, Inc. and/or its subsidiaries.
 * SPDX-License-Identifier: Apache-2.0
 */

#include <errno.h>

#include <zephyr/kernel.h>
#include <zephyr/kernel_structs.h>
#include <zephyr/sys/atomic.h>
#include <zephyr/ztest.h>

#include <kspinlock.h>
#include <latency_monitor.h>

BUILD_ASSERT(sizeof(struct k_spinlock) > 0U, "Tracked locks need distinct addresses");

static struct {
	bool enabled;
	uint32_t cycles;
} test_clocks[CONFIG_MP_MAX_NUM_CPUS];

uint32_t __real_sys_clock_cycle_get_32(void);
uint32_t __wrap_sys_clock_cycle_get_32(void);

uint32_t __wrap_sys_clock_cycle_get_32(void)
{
	unsigned int key = arch_irq_lock();
	unsigned int cpu = CPU_ID;
	uint32_t cycles = test_clocks[cpu].enabled ? test_clocks[cpu].cycles
						   : __real_sys_clock_cycle_get_32();

	arch_irq_unlock(key);
	return cycles;
}

/* The caller keeps raw local IRQs locked until the real clock is restored. */
static void set_test_clock(uint32_t cycles)
{
	unsigned int cpu = CPU_ID;

	test_clocks[cpu].cycles = cycles;
	test_clocks[cpu].enabled = true;
}

static void restore_clock(void)
{
	test_clocks[CPU_ID].enabled = false;
}

ZTEST(kernel_latency_monitor, test_exact_irq_timing)
{
	struct z_latency_monitor_stats nested;
	struct z_latency_monitor_stats wrapped;
	struct z_latency_monitor_stats tied;
	struct z_latency_monitor_stats restarted;
	unsigned int key = arch_irq_lock();
	unsigned int inner_key = arch_irq_lock();
	unsigned int cpu = CPU_ID;

	z_latency_monitor_stats_reset();
	set_test_clock(UINT32_MAX - 10U);
	z_latency_monitor_irq_start(key, NULL, 1U);
	set_test_clock(0U);
	z_latency_monitor_irq_start(inner_key, NULL, 2U);
	z_latency_monitor_irq_end(inner_key);
	(void)z_latency_monitor_stats_get(cpu, &nested);
	/* Reset must preserve the active interval, even across a counter wrap. */
	z_latency_monitor_stats_reset();
	set_test_clock(15U);
	z_latency_monitor_irq_end(key);
	(void)z_latency_monitor_stats_get(cpu, &wrapped);

	set_test_clock(100U);
	z_latency_monitor_irq_start(key, NULL, 2U);
	set_test_clock(126U);
	z_latency_monitor_irq_end(key);
	(void)z_latency_monitor_stats_get(cpu, &tied);

	/* A hardware-enabled entry replaces any stale, unpaired interval. */
	set_test_clock(200U);
	z_latency_monitor_irq_start(key, NULL, 2U);
	set_test_clock(300U);
	z_latency_monitor_irq_start(key, NULL, 3U);
	set_test_clock(340U);
	z_latency_monitor_irq_end(key);
	(void)z_latency_monitor_stats_get(cpu, &restarted);
	restore_clock();
	arch_irq_unlock(key);

	zassert_equal(nested.max[Z_LATENCY_MONITOR_EVENT_IRQ_LOCKED].cycles, 0U);
	zassert_equal(wrapped.max[Z_LATENCY_MONITOR_EVENT_IRQ_LOCKED].cycles, 26U);
	zassert_equal(wrapped.max[Z_LATENCY_MONITOR_EVENT_IRQ_LOCKED].caller, 1U);
	zassert_equal(tied.max[Z_LATENCY_MONITOR_EVENT_IRQ_LOCKED].cycles, 26U);
	zassert_equal(tied.max[Z_LATENCY_MONITOR_EVENT_IRQ_LOCKED].caller, 1U);
	zassert_equal(restarted.max[Z_LATENCY_MONITOR_EVENT_IRQ_LOCKED].cycles, 40U);
	zassert_equal(restarted.max[Z_LATENCY_MONITOR_EVENT_IRQ_LOCKED].caller, 3U);
}

ZTEST(kernel_latency_monitor, test_exact_spin_depth_recovery)
{
	struct k_spinlock locks[CONFIG_KERNEL_LATENCY_MONITOR_MAX_SPINLOCK_DEPTH + 1] = {0};
	k_spinlock_key_t keys[ARRAY_SIZE(locks)];
	struct z_latency_monitor_stats overflow;
	struct z_latency_monitor_stats recovered;
	unsigned int key = arch_irq_lock();
	unsigned int cpu = CPU_ID;

	z_latency_monitor_stats_reset();
	set_test_clock(0U);
	z_latency_monitor_irq_start(key, &locks[0], 1U);
	for (size_t i = 0; i < ARRAY_SIZE(locks); ++i) {
		set_test_clock(i * 10U);
		keys[i] = k_spin_lock(&locks[i]);
	}

	set_test_clock(1000U);
	for (size_t i = ARRAY_SIZE(locks); i > 0; --i) {
		k_spin_unlock(&locks[i - 1U], keys[i - 1U]);
	}
	z_latency_monitor_irq_end(key);
	(void)z_latency_monitor_stats_get(cpu, &overflow);

	z_latency_monitor_stats_reset();
	set_test_clock(2000U);
	keys[0] = k_spin_lock(&locks[0]);
	set_test_clock(2050U);
	k_spin_unlock(&locks[0], keys[0]);
	(void)z_latency_monitor_stats_get(cpu, &recovered);
	restore_clock();
	arch_irq_unlock(key);

	zassert_equal(overflow.spinlock_tracking_overflows, 1U);
	zassert_equal(overflow.max[Z_LATENCY_MONITOR_EVENT_IRQ_LOCKED].cycles, 1000U);
	zassert_equal(overflow.max[Z_LATENCY_MONITOR_EVENT_SPINLOCK_HOLD].cycles, 1000U);
	zassert_equal_ptr(overflow.max[Z_LATENCY_MONITOR_EVENT_SPINLOCK_HOLD].spinlock, &locks[0]);
	zassert_equal(recovered.spinlock_tracking_overflows, 0U);
	zassert_equal(recovered.max[Z_LATENCY_MONITOR_EVENT_SPINLOCK_HOLD].cycles, 50U);
	zassert_equal_ptr(recovered.max[Z_LATENCY_MONITOR_EVENT_SPINLOCK_HOLD].spinlock, &locks[0]);
}

ZTEST(kernel_latency_monitor, test_exact_crossed_spin_release)
{
	struct k_spinlock locks[3] = {0};
	struct z_latency_monitor_stats middle;
	struct z_latency_monitor_stats last;
	unsigned int key = arch_irq_lock();
	unsigned int cpu = CPU_ID;

	z_latency_monitor_stats_reset();
	set_test_clock(100U);
	(void)k_spin_lock(&locks[0]);
	set_test_clock(200U);
	(void)k_spin_lock(&locks[1]);
	set_test_clock(300U);
	(void)k_spin_lock(&locks[2]);
	set_test_clock(400U);
	k_spin_release(&locks[1]);
	(void)z_latency_monitor_stats_get(cpu, &middle);
	set_test_clock(450U);
	k_spin_release(&locks[0]);
	set_test_clock(600U);
	k_spin_release(&locks[2]);
	(void)z_latency_monitor_stats_get(cpu, &last);
	restore_clock();
	arch_irq_unlock(key);

	zassert_equal(middle.max[Z_LATENCY_MONITOR_EVENT_SPINLOCK_HOLD].cycles,
		      CONFIG_KERNEL_LATENCY_MONITOR_MAX_SPINLOCK_DEPTH > 1 ? 200U : 0U);
	zassert_equal(last.max[Z_LATENCY_MONITOR_EVENT_SPINLOCK_HOLD].cycles, 350U);
	zassert_equal_ptr(last.max[Z_LATENCY_MONITOR_EVENT_SPINLOCK_HOLD].spinlock, &locks[0]);
	zassert_equal(last.spinlock_tracking_overflows,
		      3U - MIN(3U, CONFIG_KERNEL_LATENCY_MONITOR_MAX_SPINLOCK_DEPTH));
}

ZTEST(kernel_latency_monitor, test_exact_slot_reuse_after_overflow)
{
	struct k_spinlock locks[CONFIG_KERNEL_LATENCY_MONITOR_MAX_SPINLOCK_DEPTH + 2] = {0};
	struct z_latency_monitor_stats released;
	struct z_latency_monitor_stats untracked;
	struct z_latency_monitor_stats reused;
	unsigned int capacity = CONFIG_KERNEL_LATENCY_MONITOR_MAX_SPINLOCK_DEPTH;
	unsigned int key = arch_irq_lock();
	unsigned int cpu = CPU_ID;

	z_latency_monitor_stats_reset();
	for (unsigned int i = 0U; i <= capacity; ++i) {
		set_test_clock(100U + i * 10U);
		(void)k_spin_lock(&locks[i]);
	}
	/* Free a tracked slot while the overflowed lock remains held. */
	set_test_clock(500U);
	k_spin_release(&locks[0]);
	(void)z_latency_monitor_stats_get(cpu, &released);
	z_latency_monitor_stats_reset();
	set_test_clock(1000U);
	(void)k_spin_lock(&locks[capacity + 1U]);
	set_test_clock(2000U);
	k_spin_release(&locks[capacity]);
	(void)z_latency_monitor_stats_get(cpu, &untracked);
	set_test_clock(2100U);
	k_spin_release(&locks[capacity + 1U]);
	(void)z_latency_monitor_stats_get(cpu, &reused);
	for (unsigned int i = capacity; i > 1U; --i) {
		k_spin_release(&locks[i - 1U]);
	}
	restore_clock();
	arch_irq_unlock(key);

	zassert_equal(released.spinlock_tracking_overflows, 1U);
	zassert_equal(released.max[Z_LATENCY_MONITOR_EVENT_SPINLOCK_HOLD].cycles, 400U);
	zassert_equal_ptr(released.max[Z_LATENCY_MONITOR_EVENT_SPINLOCK_HOLD].spinlock, &locks[0]);
	zassert_equal(untracked.max[Z_LATENCY_MONITOR_EVENT_SPINLOCK_HOLD].cycles, 0U);
	zassert_equal(reused.spinlock_tracking_overflows, 0U);
	zassert_equal(reused.max[Z_LATENCY_MONITOR_EVENT_SPINLOCK_HOLD].cycles, 1100U);
	zassert_equal_ptr(reused.max[Z_LATENCY_MONITOR_EVENT_SPINLOCK_HOLD].spinlock,
			  &locks[capacity + 1U]);
}

#define PEND_STACK_SIZE (1536 + CONFIG_TEST_EXTRA_STACK_SIZE)

K_THREAD_STACK_DEFINE(pend_stack, PEND_STACK_SIZE);
K_SEM_DEFINE(pend_sem, 0, 1);
static struct k_thread pend_thread;
static struct pend_capture {
	struct k_thread *origin;
	struct k_spinlock *object_lock;
	const struct k_spinlock *next_release;
	struct z_latency_monitor_stats object;
	struct z_latency_monitor_stats scheduler;
} pend_captures[CONFIG_MP_MAX_NUM_CPUS];

int __real_z_pend_curr(struct k_spinlock *lock, k_spinlock_key_t key, _wait_q_t *wait_q,
		       k_timeout_t timeout);
int __wrap_z_pend_curr(struct k_spinlock *lock, k_spinlock_key_t key, _wait_q_t *wait_q,
		       k_timeout_t timeout);
void __real_z_latency_monitor_spin_released(const struct k_spinlock *lock);
void __wrap_z_latency_monitor_spin_released(const struct k_spinlock *lock);

int __wrap_z_pend_curr(struct k_spinlock *lock, k_spinlock_key_t key, _wait_q_t *wait_q,
		       k_timeout_t timeout)
{
	struct pend_capture *capture = &pend_captures[CPU_ID];

	if (capture->origin == _current) {
		capture->object_lock = lock;
		capture->next_release = lock;
		capture->origin = NULL;
	}
	return __real_z_pend_curr(lock, key, wait_q, timeout);
}

void __wrap_z_latency_monitor_spin_released(const struct k_spinlock *lock)
{
	struct pend_capture *capture = &pend_captures[CPU_ID];
	struct z_latency_monitor_stats *stats = NULL;

	if (lock == capture->next_release) {
		bool object = lock == capture->object_lock;

		stats = object ? &capture->object : &capture->scheduler;
		capture->next_release = object ? &_sched_spinlock : NULL;
		/* Isolate each release from unrelated maxima without changing held locks. */
		z_latency_monitor_stats_reset();
		k_busy_wait(1U);
	}
	__real_z_latency_monitor_spin_released(lock);
	if (stats != NULL) {
		(void)z_latency_monitor_stats_get(CPU_ID, stats);
	}
}

static void wake_pended_thread(void *p1, void *p2, void *p3)
{
	ARG_UNUSED(p1);
	ARG_UNUSED(p2);
	ARG_UNUSED(p3);

	k_sem_give(&pend_sem);
}

ZTEST(kernel_latency_monitor, test_blocking_pend_tracks_both_locks)
{
	const struct z_latency_monitor_record *record;
	struct k_thread *origin = k_current_get();
	struct pend_capture *capture;
	unsigned int key;
	unsigned int cpu;
	k_tid_t waker;
	int result;

	k_sched_lock();
	key = arch_irq_lock();
	cpu = CPU_ID;
	capture = &pend_captures[cpu];
	*capture = (struct pend_capture){.origin = origin};
	arch_irq_unlock(key);
	waker = k_thread_create(&pend_thread, pend_stack, K_THREAD_STACK_SIZEOF(pend_stack),
				wake_pended_thread, NULL, NULL, NULL,
				k_thread_priority_get(origin) + 1, 0, K_FOREVER);
#ifdef CONFIG_SMP
	zassert_ok(k_thread_cpu_pin(waker, cpu));
#endif
	k_thread_start(waker);
	result = k_sem_take(&pend_sem, K_FOREVER);
	k_sched_unlock();
	zassert_ok(k_thread_join(waker, K_SECONDS(1)));

	zassert_ok(result);
	zassert_not_null(capture->object_lock, "did not block in z_pend_curr");
	zassert_is_null(capture->next_release, "did not observe both pend releases");
	record = &capture->object.max[Z_LATENCY_MONITOR_EVENT_SPINLOCK_HOLD];
	zassert_true(record->cycles > 0U);
	zassert_equal_ptr(record->spinlock, capture->object_lock);
	zassert_equal_ptr(record->thread, origin);
	if (CONFIG_KERNEL_LATENCY_MONITOR_MAX_SPINLOCK_DEPTH > 1) {
		record = &capture->scheduler.max[Z_LATENCY_MONITOR_EVENT_SPINLOCK_HOLD];
		zassert_true(record->cycles > 0U);
		zassert_equal_ptr(record->spinlock, &_sched_spinlock);
		zassert_equal_ptr(record->thread, origin);
	}
}

#ifdef CONFIG_SMP

#define SNAPSHOT_ITERATIONS 10000U
#define SNAPSHOT_STACK_SIZE (1536 + CONFIG_TEST_EXTRA_STACK_SIZE)

K_THREAD_STACK_DEFINE(writer_stack, SNAPSHOT_STACK_SIZE);
static struct k_thread writer_thread;
static struct k_spinlock record_locks[2];
static atomic_t writer_ready;
static atomic_t reader_ready;
static atomic_t writer_done;
static atomic_t reader_done;

static void snapshot_writer(void *p1, void *p2, void *p3)
{
	unsigned int key = arch_irq_lock();

	ARG_UNUSED(p1);
	ARG_UNUSED(p2);
	ARG_UNUSED(p3);

	z_latency_monitor_stats_reset();
	atomic_set(&writer_ready, 1);
	while (atomic_get(&reader_ready) == 0) {
		arch_spin_relax();
	}

	for (uint32_t i = 1U; i <= SNAPSHOT_ITERATIONS; ++i) {
		if ((i % 64U) == 0U) {
			z_latency_monitor_stats_reset();
		}
		set_test_clock(0U);
		z_latency_monitor_irq_start(key, &record_locks[i % 2U], i);
		set_test_clock(i);
		z_latency_monitor_irq_end(key);
	}

	atomic_set(&writer_done, 1);
	/* Keep unrelated scheduling/ISR records out until the reader finishes. */
	while (atomic_get(&reader_done) == 0) {
		arch_spin_relax();
	}
	restore_clock();
	arch_irq_unlock(key);
}

static bool valid_snapshot(const struct z_latency_monitor_stats *stats)
{
	const struct z_latency_monitor_record *record =
		&stats->max[Z_LATENCY_MONITOR_EVENT_IRQ_LOCKED];

	if (stats->spinlock_tracking_overflows != 0U ||
	    stats->max[Z_LATENCY_MONITOR_EVENT_SPINLOCK_WAIT].cycles != 0U ||
	    stats->max[Z_LATENCY_MONITOR_EVENT_SPINLOCK_HOLD].cycles != 0U) {
		return false;
	}

	if (record->cycles == 0U) {
		return record->caller == 0U && record->spinlock == NULL && record->thread == NULL &&
		       !record->in_isr;
	}

	return record->cycles <= SNAPSHOT_ITERATIONS && record->caller == record->cycles &&
	       record->spinlock == &record_locks[record->cycles % 2U] &&
	       record->thread == &writer_thread && !record->in_isr;
}

ZTEST(kernel_latency_monitor, test_smp_remote_snapshot)
{
	struct z_latency_monitor_stats stats;
	unsigned int attempts = 0U;
	bool snapshot_failed = false;
	unsigned int cpu;
	k_tid_t writer;

	atomic_clear(&writer_ready);
	atomic_clear(&reader_ready);
	atomic_clear(&writer_done);
	atomic_clear(&reader_done);
	/* Keep this reader on one CPU and run the writer on another. */
	k_sched_lock();
	cpu = (arch_curr_cpu()->id + 1U) % arch_num_cpus();
	writer =
		k_thread_create(&writer_thread, writer_stack, K_THREAD_STACK_SIZEOF(writer_stack),
				snapshot_writer, NULL, NULL, NULL, K_PRIO_PREEMPT(1), 0, K_FOREVER);
	zassert_ok(k_thread_cpu_pin(writer, cpu));
	k_thread_start(writer);

	while (atomic_get(&writer_ready) == 0) {
		k_busy_wait(1U);
	}

	atomic_set(&reader_ready, 1);
	do {
		int ret = z_latency_monitor_stats_get(cpu, &stats);

		if ((ret == 0 && !valid_snapshot(&stats)) || (ret != 0 && ret != -EAGAIN)) {
			snapshot_failed = true;
		}
		++attempts;
	} while (atomic_get(&writer_done) == 0);

	if (z_latency_monitor_stats_get(cpu, &stats) != 0 || !valid_snapshot(&stats) ||
	    stats.max[Z_LATENCY_MONITOR_EVENT_IRQ_LOCKED].cycles != SNAPSHOT_ITERATIONS) {
		snapshot_failed = true;
	}
	atomic_set(&reader_done, 1);
	k_sched_unlock();
	zassert_ok(k_thread_join(writer, K_SECONDS(5)));
	zassert_false(snapshot_failed, "mixed publication/reset snapshot");
	zassert_true(attempts > 1U, "no concurrent snapshot attempts exercised");
}

#endif /* CONFIG_SMP */
```
