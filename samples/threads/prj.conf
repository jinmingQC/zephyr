## CMakeLists.txt
```
# SPDX-FileCopyrightText: Copyright The Zephyr Project Contributors
# SPDX-License-Identifier: Apache-2.0

cmake_minimum_required(VERSION 3.20.0)
find_package(Zephyr REQUIRED HINTS $ENV{ZEPHYR_BASE})
project(libcxx_threads LANGUAGES C CXX)

target_sources(app PRIVATE
  src/main.cpp
)
```

## prj.conf
```kconfig
# SPDX-FileCopyrightText: Copyright The Zephyr Project Contributors
# SPDX-License-Identifier: Apache-2.0

CONFIG_CPP=y
CONFIG_STD_CPP17=y
CONFIG_CPP_RUNTIME=y
CONFIG_EXTERNAL_MODULE_LIBCPP=y
CONFIG_PICOLIBC=y
CONFIG_CPP_EXCEPTIONS=n
CONFIG_CPP_RTTI=n
CONFIG_THREAD_LOCAL_STORAGE=y

CONFIG_CPP_RUNTIME_THREAD_MAX=8
CONFIG_CPP_RUNTIME_THREAD_STACK_SIZE=4096
CONFIG_CPP_RUNTIME_THREAD_PRIORITY=5
CONFIG_CPP_RUNTIME_TLS_KEYS=8

CONFIG_MAIN_STACK_SIZE=4096
CONFIG_MAIN_THREAD_PRIORITY=5
CONFIG_SYSTEM_WORKQUEUE_STACK_SIZE=4096
CONFIG_COMMON_LIBC_MALLOC=y
CONFIG_COMMON_LIBC_MALLOC_ARENA_SIZE=32768
CONFIG_HEAP_MEM_POOL_SIZE=8192
CONFIG_POSIX_SYSTEM_INTERFACES=y
CONFIG_POSIX_TIMERS=y
CONFIG_POSIX_MONOTONIC_CLOCK=y
```

## src/main.cpp
```c
/*
 * SPDX-FileCopyrightText: Copyright The Zephyr Project Contributors
 * SPDX-License-Identifier: Apache-2.0
 */

#include <array>
#include <condition_variable>
#include <cstdint>
#include <cstdio>
#include <mutex>
#include <thread>

int main()
{
	std::mutex mutex;
	std::condition_variable ready;
	bool start = false;
	uint32_t count = 0;
	std::array<std::thread, 4> workers;

	for (auto &worker : workers) {
		worker = std::thread([&]() {
			{
				std::unique_lock<std::mutex> lock(mutex);

				ready.wait(lock, [&]() { return start; });
			}
			for (uint32_t i = 0; i < 1000; ++i) {
				std::lock_guard<std::mutex> lock(mutex);

				++count;
			}
		});
	}

	{
		std::lock_guard<std::mutex> lock(mutex);

		start = true;
	}
	ready.notify_all();
	for (auto &worker : workers) {
		worker.join();
	}
	std::printf("libc++ threads: %u increments\n", static_cast<unsigned int>(count));
	return count == 4000 ? 0 : 1;
}
```
