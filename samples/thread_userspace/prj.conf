## CMakeLists.txt
```
# SPDX-License-Identifier: Apache-2.0
cmake_minimum_required(VERSION 3.28.0)
find_package(Zephyr REQUIRED HINTS $ENV{ZEPHYR_BASE})
project(cpp_runtime_userspace)
target_sources(app PRIVATE src/main.cpp)
```

## sample.yaml
```
# SPDX-License-Identifier: Apache-2.0
sample:
  name: C++ native userspace threading
tests:
  sample.cpp.runtime.userspace:
    filter: CONFIG_ARCH_HAS_USERSPACE
    platform_allow:
      - mps2/an385
      - qemu_riscv32
    tags:
      - cpp
      - userspace
    harness: console
    harness_config:
      type: one_line
      regex:
        - "C\\+\\+ user caller=1 worker result=42"
```

## prj.conf
```kconfig
# SPDX-License-Identifier: Apache-2.0
CONFIG_CPP=y
CONFIG_STD_CPP17=y
CONFIG_CPP_RUNTIME=y
CONFIG_EXTERNAL_MODULE_LIBCPP=y
CONFIG_PICOLIBC=y
CONFIG_CPP_EXCEPTIONS=n
CONFIG_CPP_RTTI=n
CONFIG_USERSPACE=y
CONFIG_HW_STACK_PROTECTION=y
CONFIG_MAIN_STACK_SIZE=4096
CONFIG_MAIN_THREAD_PRIORITY=5
CONFIG_CPP_RUNTIME_THREAD_STACK_SIZE=4096
CONFIG_COMMON_LIBC_MALLOC=y
CONFIG_COMMON_LIBC_MALLOC_ARENA_SIZE=32768
CONFIG_POSIX_SYSTEM_INTERFACES=y
CONFIG_POSIX_TIMERS=y
CONFIG_POSIX_MONOTONIC_CLOCK=y
```

## src/main.cpp
```c
/*
 * SPDX-FileCopyrightText: Copyright The Zephyr Project Contributors
 * SPDX-License-Identifier: Apache-2.0
 */

#include <atomic>
#include <condition_variable>
#include <memory>
#include <mutex>
#include <thread>
#include <cpp_runtime/thread.h>
#include <cpp_runtime/userspace.h>
#include <zephyr/app_memory/app_memdomain.h>
#include <zephyr/sys/libc-hooks.h>
#include <zephyr/sys/printk.h>

K_THREAD_STACK_DEFINE(application_stack, 8192);
static struct k_thread application_thread;

struct shared_state {
	std::mutex mutex;
	std::condition_variable ready;
	bool complete = false;
	int answer = 0;
};

/* All C++ runtime use after activation takes place in this application domain.
 * Captures point into the shared application heap, never the parent's stack. */
static void application_body()
{
	auto state = std::make_shared<shared_state>();
	std::thread worker([state] {
		std::lock_guard<std::mutex> lock(state->mutex);

		state->answer = k_is_user_context() ? 42 : -1;
		state->complete = true;
		state->ready.notify_one();
	});

	{
		std::unique_lock<std::mutex> lock(state->mutex);

		state->ready.wait(lock, [state] { return state->complete; });
	}
	worker.join();
	printk("C++ user caller=%d worker result=%d\n", k_is_user_context(), state->answer);
}

static void application_entry(void *, void *, void *)
{
	application_body();
	/* All automatic objects are gone before language TLS and TSS cleanup. */
	cpp_runtime_thread_cleanup();
}

/* Privileged bootstrap uses C/Zephyr APIs only. It never consumes user heap
 * objects, C++ handler callbacks or runtime state once the user thread starts. */
int main()
{
	int ret = cpp_runtime_userspace_init(&k_mem_domain_default);

	if (ret != 0) {
		printk("runtime domain setup failed: %d\n", ret);
		return ret;
	}
#if Z_MALLOC_PARTITION_EXISTS
	ret = k_mem_domain_add_partition(&k_mem_domain_default, &z_malloc_partition);
	if (ret != 0) {
		printk("application heap setup failed: %d\n", ret);
		return ret;
	}
#endif
	k_tid_t child = k_thread_create(&application_thread, application_stack,
				       K_THREAD_STACK_SIZEOF(application_stack),
				       application_entry, nullptr, nullptr, nullptr,
				       5, K_USER | K_INHERIT_PERMS, K_NO_WAIT);

	return k_thread_join(child, K_FOREVER);
}
```
