## CMakeLists.txt
```
# SPDX-FileCopyrightText: Copyright The Zephyr Project Contributors
# SPDX-License-Identifier: Apache-2.0

cmake_minimum_required(VERSION 3.20.0)
find_package(Zephyr REQUIRED HINTS $ENV{ZEPHYR_BASE})
project(cpp_runtime_minimal LANGUAGES C CXX)
target_sources(app PRIVATE src/main.cpp)
```

## prj.conf
```kconfig
# SPDX-FileCopyrightText: Copyright The Zephyr Project Contributors
# SPDX-License-Identifier: Apache-2.0

CONFIG_CPP=y
CONFIG_STD_CPP17=y
CONFIG_CPP_RUNTIME=y
CONFIG_EXTERNAL_MODULE_LIBCPP=y
CONFIG_PICOLIBC=y
CONFIG_PICOLIBC_IO_LONG_LONG=y
CONFIG_CPP_EXCEPTIONS=n
CONFIG_CPP_RTTI=n
CONFIG_THREAD_LOCAL_STORAGE=y
CONFIG_SPEED_OPTIMIZATIONS=y

CONFIG_CPP_RUNTIME_THREAD_MAX=8
CONFIG_CPP_RUNTIME_THREAD_STACK_SIZE=4096
CONFIG_CPP_RUNTIME_THREAD_PRIORITY=5
CONFIG_CPP_RUNTIME_TLS_KEYS=8

CONFIG_MAIN_THREAD_PRIORITY=5
CONFIG_MAIN_STACK_SIZE=8192
CONFIG_SYSTEM_WORKQUEUE_STACK_SIZE=4096
CONFIG_COMMON_LIBC_MALLOC=y
CONFIG_COMMON_LIBC_MALLOC_ARENA_SIZE=32768
CONFIG_HEAP_MEM_POOL_SIZE=8192
CONFIG_POSIX_SYSTEM_INTERFACES=y
CONFIG_POSIX_TIMERS=y
CONFIG_POSIX_MONOTONIC_CLOCK=y
```

## src/main.cpp
```c
/*
 * SPDX-FileCopyrightText: Copyright The Zephyr Project Contributors
 * SPDX-License-Identifier: Apache-2.0
 */

int main()
{
	return 0;
}
```
